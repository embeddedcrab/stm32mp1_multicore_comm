## meta-stm32mp/conf/layer.conf
```bitbake
# We have a conf and classes directory, add to BBPATH
BBPATH .= ":${LAYERDIR}"

# We have recipes-* directories, add to BBFILES
BBFILES += "${LAYERDIR}/recipes-*/*/*.bb \
            ${LAYERDIR}/recipes-*/*/*.bbappend"

BBFILE_COLLECTIONS += "meta-stm32mp"
BBFILE_PATTERN_meta-stm32mp = "^${LAYERDIR}/"
BBFILE_PRIORITY_meta-stm32mp = "6"

LAYERDEPENDS_meta-stm32mp = "core"
LAYERSERIES_COMPAT_meta-stm32mp = "dunfell"
```
